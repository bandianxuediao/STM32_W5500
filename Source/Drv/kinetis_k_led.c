/*********************************************Copyright (c)***********************************************
**                                Guangzhou ZLG MCU Technology Co., Ltd.
**
**                                        http://www.zlgmcu.com
**
**      广州周立功单片机科技有限公司所提供的所有服务内容旨在协助客户加速产品的研发进度，在服务过程中所提供
**  的任何程序、文档、测试结果、方案、支持等资料和信息，都仅供参考，客户有权不使用或自行参考修改，本公司不
**  提供任何的完整性、可靠性等保证，若在客户使用过程中因任何原因造成的特别的、偶然的或间接的损失，本公司不
**  承担任何责任。
**                                                                        ——广州周立功单片机科技有限公司
**
**--------------File Info---------------------------------------------------------------------------------
** File name:               Led.c
** Last modified date:      2012-12-12
** Last version:            V1.0
** Description:             LED驱动文件
**
**--------------------------------------------------------------------------------------------------------
** Created by:              Hong Haogao
** Created date:            2012-12-12
** Version:                 V1.0
** Descriptions:            The original version 初始版本
**
**--------------------------------------------------------------------------------------------------------
** Modified by:             
** Modified date:           
** Version:                 
** Descriptions:            
**
*********************************************************************************************************/
#include "..\App\Includes.h"

/*********************************************************************************************************
** Function name:           ledInit
** Descriptions:            LED 初始化
** Input parameters:        none
** Output parameters:       none
** Returned value:          none
** Created by:              Hong Haogao
** Created date:            2012-12-12
**--------------------------------------------------------------------------------------------------------
** Modified by:             
** Modified date:           
*********************************************************************************************************/
void  ledInit (void)
{
    SIM_SCGC5  |= LED_SIM_SCGC5;                                        /* 使能端口时钟                 */
    
    LED_PCR     = PORT_PCR_MUX(1);                                      /* 引脚配置为GPIO功能           */
    LED_DOR    &= ~(1ul << LED_PIN);                                    /* LED灭                        */ 
    LED_DDR    |= 1ul << LED_PIN;                                       /* 配置LED引脚为输出引脚        */
}

/*********************************************************************************************************
** Function name:           ledOn
** Descriptions:            打开LED函数 
** Input parameters:        none
** Output parameters:       none
** Returned value:          none
** Created by:              Hong Haogao
** Created date:            2012-12-12
**--------------------------------------------------------------------------------------------------------
** Modified by:             
** Modified date:           
*********************************************************************************************************/
void   ledOn (void)
{
    LED_SET = 1ul << LED_PIN;
}

/*********************************************************************************************************
** Function name:           ledOff
** Descriptions:            关闭LED函数
** Input parameters:        none
** Output parameters:       none
** Returned value:          none
** Created by:              Hong Haogao
** Created date:            2012-12-12
**--------------------------------------------------------------------------------------------------------
** Modified by:             
** Modified date:           
*********************************************************************************************************/
void  ledOff (void)
{
    LED_CLR = 1ul << LED_PIN;
}

/*********************************************************************************************************
** Function name:           ledTog
** Descriptions:            LED状态取反函数
** Input parameters:        none
** Output parameters:       none
** Returned value:          none
** Created by:              Hong Haogao
** Created date:            2012-12-12
**--------------------------------------------------------------------------------------------------------
** Modified by:             
** Modified date:           
*********************************************************************************************************/
void  ledTog (void)
{
    LED_TOG = 1ul << LED_PIN;
}

/*********************************************************************************************************
** Function name:           ledBlink
** Descriptions:            LED不断闪烁函数
** Input parameters:        ulDly：闪烁参数，值越大闪烁越慢
** Output parameters:       none
** Returned value:          none
** Created by:              Hong Haogao
** Created date:            2013-01-10
**--------------------------------------------------------------------------------------------------------
** Modified by:             
** Modified date:           
*********************************************************************************************************/
void  ledBlink (INT32U  ulDly)
{
    volatile INT32U  i, j;
    
    while (1) {
        for (i = 0; i < ulDly; i++) {
            for (j = 0; j < 500; j++) {
            }
        }
        ledTog();
    };
}

/*********************************************************************************************************
  END FILE 
*********************************************************************************************************/
